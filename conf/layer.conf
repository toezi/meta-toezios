## conf/layer.conf
```bitbake
# We have a conf and classes directory, append to BBPATH
BBPATH .= ":${LAYERDIR}"

# We have a recipes directory containing .bb and .bbappend files, add to BBFILES
BBFILES += "${LAYERDIR}/recipes*/*/*.bb \
            ${LAYERDIR}/recipes*/*/*.bbappend"

BBFILE_COLLECTIONS += "toezios"
BBFILE_PATTERN_toezios := "^${LAYERDIR}/"
BBFILE_PRIORITY_toezios = "10"
LAYERSERIES_COMPAT_toezios = "kirkstone"
```
